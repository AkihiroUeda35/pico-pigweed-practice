## apps/west.yml
```yaml
manifest:
  self:
    path: .
  remotes:
    - name: zephyrproject-rtos
      url-base: https://github.com/zephyrproject-rtos
    - name: google
      url-base: https://github.com/google
  projects:
    - name: zephyr
      remote: zephyrproject-rtos
      revision: main
      import: true
    - name: pigweed
      remote: google
      revision: main 
      path: modules/lib/pigweed
```

## manifest/west.yml
```yaml
manifest:
  self:
    path: .
  remotes:
    - name: zephyrproject-rtos
      url-base: https://github.com/zephyrproject-rtos
    - name: pigweed-project
      url-base: https://github.com/pigweed-project
  projects:
    - name: zephyr
      remote: zephyrproject-rtos
      revision: main
      import: true
      path: third_party/pigweed/environment/packages/zephyr
    - name: pigweed
      remote: pigweed-project
      revision: main 
      path: third_party/pigweed
      import: false
```

## west.yml
```yaml
manifest:
  self:
    path: src  # directory for your application code

  remotes:
    - name: zephyrproject-rtos
      url-base: https://github.com/zephyrproject-rtos

  projects:
    - name: zephyr
      remote: zephyrproject-rtos
      revision: main    # to use raspberrypi/pico-2/rp2350a/m33, use revision main
      import: true    
```
